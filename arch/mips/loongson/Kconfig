## arch/mips/loongson/Kconfig
```kconfig
choice
    prompt "Machine Type"
    depends on MACH_LOONGSON

config LEMOTE_FULOONG2E
    bool "Lemote Fuloong(2e) mini-PC"
    select ARCH_SPARSEMEM_ENABLE
    select CEVT_R4K
    select CSRC_R4K
    select SYS_HAS_CPU_LOONGSON2E
    select DMA_NONCOHERENT
    select BOOT_ELF32
    select BOARD_SCACHE
    select HW_HAS_PCI
    select I8259
    select ISA
    select IRQ_CPU
    select SYS_SUPPORTS_32BIT_KERNEL
    select SYS_SUPPORTS_64BIT_KERNEL
    select SYS_SUPPORTS_LITTLE_ENDIAN
    select SYS_SUPPORTS_HIGHMEM
    select SYS_HAS_EARLY_PRINTK
    select GENERIC_HARDIRQS_NO__DO_IRQ
    select GENERIC_ISA_DMA_SUPPORT_BROKEN
    select CPU_HAS_WB
    help
      Lemote Fuloong(2e) mini-PC board based on the Chinese Loongson-2E CPU and
      an FPGA northbridge

      Lemote Fuloong(2e) mini PC have a VIA686B south bridge.
endchoice




choice
	prompt "Machine Type"
	depends on MACH_LOONGSON_LS1X

config LOONGSON_LS1A_BOARD
	bool "Loongson LS1A development board"
	select ARCH_SPARSEMEM_ENABLE
	select BOOT_ELF32
	select CEVT_R4K if ! MIPS_EXTERNAL_TIMER
	select CPU_HAS_WB
	select CSRC_R4K if ! MIPS_EXTERNAL_TIMER
	select DMA_NONCOHERENT
	select GENERIC_HARDIRQS_NO__DO_IRQ
	select GENERIC_ISA_DMA_SUPPORT_BROKEN
	select HW_HAS_PCI
	select I8259
	select IRQ_CPU
	select SYS_HAS_CPU_LOONGSON232
	select SYS_HAS_EARLY_PRINTK
	select SYS_SUPPORTS_32BIT_KERNEL
	select SYS_SUPPORTS_HIGHMEM
	select SYS_SUPPORTS_LITTLE_ENDIAN
	select MACH_LS1A
	help
	  Loongson 2F test board is a soc system,which uses loongson 232 cpu core.

config LOONGSON_LS1B_BOARD
	bool "Loongson LS1B development board"
	select ARCH_SPARSEMEM_ENABLE
	select BOOT_ELF32
	select CEVT_R4K if ! MIPS_EXTERNAL_TIMER
	select CPU_HAS_WB
	select CSRC_R4K if ! MIPS_EXTERNAL_TIMER
	select DMA_NONCOHERENT
	select GENERIC_HARDIRQS_NO__DO_IRQ
	select GENERIC_ISA_DMA_SUPPORT_BROKEN
	select HW_HAS_PCI
	select I8259
	select IRQ_CPU
	select SYS_HAS_CPU_LOONGSON232
	select SYS_HAS_EARLY_PRINTK
	select SYS_SUPPORTS_32BIT_KERNEL
	select SYS_SUPPORTS_HIGHMEM
	select SYS_SUPPORTS_LITTLE_ENDIAN
	select MACH_LS1B
	help
	  Loongson 2F test board is a soc system,which uses loongson 232 cpu core.

config LOONGSON_LS232_BOARD
	bool "Loongson LS232 development board"
	select ARCH_SPARSEMEM_ENABLE
	select BOOT_ELF32
	select CEVT_R4K if ! MIPS_EXTERNAL_TIMER
	select CPU_HAS_WB
	select CSRC_R4K if ! MIPS_EXTERNAL_TIMER
	select DMA_NONCOHERENT
	select GENERIC_HARDIRQS_NO__DO_IRQ
	select GENERIC_ISA_DMA_SUPPORT_BROKEN
	select HW_HAS_PCI
	select I8259
	select IRQ_CPU
	select SYS_HAS_CPU_LOONGSON232
	select SYS_HAS_EARLY_PRINTK
	select SYS_SUPPORTS_32BIT_KERNEL
	select SYS_SUPPORTS_HIGHMEM
	select SYS_SUPPORTS_LITTLE_ENDIAN
	select MACH_LS232
	help
	  Loongson 2F test board is a soc system,which uses loongson 232 cpu core.

endchoice

menu "Other options"
	depends on CPU_LOONGSON232

config LOONGSON_FIX_RANDOM_INSTRUCTION_FETCH_SIDE_EFFECT_TO_DEVICE
	bool 'fix random instruction fetch\'s side effect to device for loongson cpu(special compiler)'
	default n


config LOONGSON_VIDEO_ACCELERATED
   bool 'video uncached accelerate'
	default y

config XWINDDOWMAPIO
	bool "map io space to user address space 0 for xwindow debug"
	default n

config NORECONFIG_SERIAL
	bool "no reconfig serial"
	default n

endmenu
```

## drivers/i2c/chips/Kconfig
```kconfig
#
# Miscellaneous I2C chip drivers configuration
#
# *** DEPRECATED! Do not add new entries! See Makefile ***
#

menu "Miscellaneous I2C Chip support"

config DS1682
	tristate "Dallas DS1682 Total Elapsed Time Recorder with Alarm"
	depends on EXPERIMENTAL
	help
	  If you say yes here you get support for Dallas Semiconductor
	  DS1682 Total Elapsed Time Recorder.

	  This driver can also be built as a module.  If so, the module
	  will be called ds1682.

config SENSORS_TSL2550
	tristate "Taos TSL2550 ambient light sensor"
	depends on EXPERIMENTAL
	help
	  If you say yes here you get support for the Taos TSL2550
	  ambient light sensor.

	  This driver can also be built as a module.  If so, the module
	  will be called tsl2550.

config PCA9539
    tristate "pca9539 keyboard controler driver"
	depends on I2C
config TS_ZT2083
    tristate "zt2083 touchscreen driver"
	depends on I2C

config GPIO
    tristate "LOONSON LS1B GPIO driver"
	depends on I2C


endmenu
```
